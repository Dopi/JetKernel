## arch/arm/mach-s5pc100/Kconfig
```kconfig
# arch/arm/mach-s5pc100/Kconfig
#
# Copyright 2008 Openmoko, Inc.
# Copyright 2008 Simtec Electronics
#
# Licensed under GPLv2

# Configuration options for the S5PC100 CPU

config CPU_S5PC100
	bool
	select CPU_S5PC100_INIT
	select CPU_S5PC100_CLOCK
	help
	  Enable S5PC100 CPU support

config MACH_SMDKC100
	bool "SMDKC100"
	select CPU_S5PC100
	help
	  Machine support for the Samsung SMDKC100
```

## arch/arm/plat-s3c64xx/Kconfig
```kconfig
# arch/arm/plat-s3c64xx/Kconfig
#
# Copyright 2008 Openmoko, Inc.
# Copyright 2008 Simtec Electronics
#	Ben Dooks <ben@simtec.co.uk>
#
# Licensed under GPLv2

config PLAT_S3C64XX
	bool
	depends on ARCH_S3C64XX
	select PLAT_S3C
	select ARM_VIC
	default y
	select NO_IOPORT
	select ARCH_REQUIRE_GPIOLIB
	select S3C_GPIO_TRACK
	select S3C_GPIO_PULL_UPDOWN
	select S3C_GPIO_CFG_S3C24XX
	select S3C_GPIO_CFG_S3C64XX
	help
	  Base platform code for any Samsung S3C64XX device

if PLAT_S3C64XX

# Configuration options shared by all S3C64XX implementations

config CPU_S3C64XX_INIT
	bool
	help
	  Common initialisation code for the S3C6400 that is shared
	  by other CPUs in the series, such as the S3C6410.

config CPU_S3C64XX_CLOCK
	bool
	help
	  Common clock support code for the S3C6400 that is shared
	  by other CPUs in the series, such as the S3C6410.

# platform specific device setup

config S3C64XX_SETUP_I2C0
	bool
	default y
	help
	  Common setup code for i2c bus 0.

	  Note, currently since i2c0 is always compiled, this setup helper
	  is always compiled with it.

config S3C64XX_SETUP_I2C1
	bool
	help
	  Common setup code for i2c bus 1.

config S3C64XX_ADCTS
	bool
	default n
	help
	  Common setup code for adc and touchscreen


config PWM
	tristate "Pulse Width Modulation (PWM) Timer support"

config S3C6410_PWM
         bool "S3C6410 PWM support"
         depends on CPU_S3C6410 && PWM
         help
           S3C6410 PWM support.

config S3C64XX_DOMAIN_GATING
	bool "Support S3C64XX Domain Gating"
	depends on PM
	default n
	help
	  domain power enable / disble when each domain is not active / idle

config S3C64XX_DOMAIN_GATING_DEBUG
	bool "Support S3C64XX Domain Gating Debug"
	depends on S3C64XX_DOMAIN_GATING
	default n
	help
	  s3c64xx domain gating debug message enable / disable

endif
```

## arch/arm/plat-s5pc1xx/Kconfig
```kconfig
# arch/arm/plat-s5pc1xx/Kconfig
#
# Copyright 2008 Openmoko, Inc.
# Copyright 2008 Simtec Electronics
#	Ben Dooks <ben@simtec.co.uk>
#
# Licensed under GPLv2

config PLAT_S5PC1XX
	bool
	depends on ARCH_S5PC1XX
	select PLAT_S3C
	select ARM_VIC
	default y
	select NO_IOPORT
	select ARCH_REQUIRE_GPIOLIB
	select S3C_GPIO_TRACK
	select S3C_GPIO_PULL_UPDOWN
	select S3C_GPIO_CFG_S5PC1XX
	help
	  Base platform code for any Samsung S5PC1XX device


if PLAT_S5PC1XX
# Configuration options shared by all S5PC1XX implementations

config CPU_S5PC100_INIT
	bool
	help
	  Common initialisation code for the S5PC100 that is shared
	  by other CPUs in the series, such as the S5PC100.

config CPU_S5PC100_CLOCK
	bool
	help
	  Common clock support code for the S3C6400 that is shared
	  by other CPUs in the series, such as the S3C6410.

# platform specific device setup

config S5PC1XX_SETUP_I2C0
	bool
	default y
	help
	  Common setup code for i2c bus 0.

	  Note, currently since i2c0 is always compiled, this setup helper
	  is always compiled with it.

config S5PC1XX_SETUP_I2C1
	bool
	help
	  Common setup code for i2c bus 1.

endif
```

## drivers/media/s3c6410/camera/Kconfig
```kconfig
config VIDEO_SAMSUNG
	tristate "S3C SMDK CAMERA support"
	depends on I2C && VIDEO_V4L2 
	default y
	help
	  TBA

comment "Select CIS module type"
	depends on VIDEO_SAMSUNG


config VIDEO_SAMSUNG_S5K3AA
	tristate "S5K3AA (Samsung 1.3M CIS module, 1280x1024)"
	depends on VIDEO_SAMSUNG
	help
	  TBA

config VIDEO_SAMSUNG_S5K3BA
	tristate "S5K3BA (Samsung 2.0M CIS module, 1600x1200)"
	depends on VIDEO_SAMSUNG
	help
	  TBA

config VIDEO_SAMSUNG_S5K4BA
	tristate "S5K4BA (Samsung 2.0M CIS module, 1600x1200)"
	depends on VIDEO_SAMSUNG
	help
	  TBA

config VIDEO_ADV7180
	tristate "ADV7180 video decoder"
	depends on VIDEO_SAMSUNG
	help
	  TBA

config VIDEO_APTINA_MT9P012
	tristate "MT9P012 (Aptina 5.0M CIS module, 2592x1944)"
	depends on VIDEO_SAMSUNG
	help
	  TBA

config VIDEO_SAMSUNG_S5K4CA
	tristate "S5K4CA (3.0M CIS module, 2048x1536)"
	depends on VIDEO_SAMSUNG
	help
	  TBA

config VIDEO_SAMSUNG_PO4010
	tristate "PO4010N (0.1M CIS module, 352x288)"
	depends on VIDEO_SAMSUNG
	help
	  TBA

config VIDEO_SAMSUNG_AIT848
	tristate "AIT848 (5.0M CIS module, 2560x1920)"
	depends on VIDEO_SAMSUNG
	help
	  TBA
```

## drivers/media/s3c6410/camera/samsung/Kconfig
```kconfig
comment "Select CIS module type"
	depends on VIDEO_SAMSUNG


config VIDEO_SAMSUNG_S5K3AA
	tristate "S5K3AA (Samsung 1.3M CIS module, 1280x1024)"
	depends on VIDEO_SAMSUNG
	help
	  TBA

config VIDEO_SAMSUNG_S5K3BA
	tristate "S5K3BA (Samsung 2.0M CIS module, 1600x1200)"
	depends on VIDEO_SAMSUNG
	help
	  TBA

config VIDEO_SAMSUNG_S5K4BA
	tristate "S5K4BA (Samsung 2.0M CIS module, 1600x1200)"
	depends on VIDEO_SAMSUNG
	help
	  TBA

config VIDEO_SAMSUNG_ADV7180
	tristate "ADV7180 video decoder"
	depends on VIDEO_SAMSUNG
	help
	  TBA

config VIDEO_SAMSUNG_APTINA_MT9P012
	tristate "MT9P012 (Aptina 5.0M CIS module, 2592x1944)"
	depends on VIDEO_SAMSUNG
	help
	  TBA

config VIDEO_SAMSUNG_S5K4CA
	tristate "S5K4CA (3.0M CIS module, 2048x1536)"
	depends on VIDEO_SAMSUNG
	help
	  TBA

config VIDEO_SAMSUNG_PO4010
	tristate "PO4010N (0.1M CIS module, 352x288)"
	depends on VIDEO_SAMSUNG
	help
	  TBA

config VIDEO_SAMSUNG_AIT848
	tristate "AIT848 (5.0M CIS module, 2560x1920)"
	depends on VIDEO_SAMSUNG
	help
```

## drivers/media/s3c6410/cmm/Kconfig
```kconfig
#
## CMM configuration
##
#
##menu "S3C_CMM Support"

config S3C_CMM
    bool "Codec Memory Manager"
    depends on CPU_S3C6410
    default n
	help
	    S3C_CMM
#endmenu
```

## drivers/media/s3c6410/g2d/Kconfig
```kconfig
#
## G2D subsystem configuration
##
#
##menu "G2D Support"

config VIDEO_G2D
    bool "Samsung FIMG-2D Driver"
    depends on CPU_S3C6410
    default n
	help
	    FIMG-2D
#endmenu
```

## drivers/media/s3c6410/g3d/Kconfig
```kconfig
#
## G2D subsystem configuration
##
#
##menu "G2D Support"

config VIDEO_G3D
    bool	"Samsung FIMG-3D Driver"
    depends on CPU_S3C6410
    default n
	help
	    FIMG-3D
#endmenu
```

## drivers/media/s3c6410/jpeg/Kconfig
```kconfig
#
## G2D subsystem configuration
##
#

#menu "G2D Support"

config VIDEO_JPEG
    bool "Samsung JPEG Driver"
    depends on CPU_S3C6410
    default n
	help
	    JPEG

#endmenu
```

## drivers/media/s3c6410/mfc/Kconfig
```kconfig
#
## Makefile for MFC device driver designed by Samsung Electronics 2007
##
config VIDEO_MFC
	bool "Samsung MFC (Multi Format Codec - FIMV 1.0) Driver"
	depends on CPU_S3C6410
	default n
	---help---
		This is a Samsung Multi Format Codecs (MFC) FIMV V1.0 - driver for Samsung S3C64XX
```

## drivers/media/s3c6410/pp/Kconfig
```kconfig
#
## Makefile for MFC device driver designed by Samsung Electronics 2007
##
config VIDEO_PP
	bool "Samsung PP (Post Processor) Driver"
	depends on CPU_S3C6410
	default n
	---help---
		This is a Samsung Post Processor - driver for Samsung S3C64XX
```

## drivers/media/video/samsung/Kconfig
```kconfig
config VIDEO_SAMSUNG
	bool "Samsung Multimedia Devices"
	depends on VIDEO_CAPTURE_DRIVERS && VIDEO_V4L2
	select VIDEO_FIXED_MINOR_RANGES
	default n
	---help---
	  This is a representative video4linux configuration for Samsung multimedia devices.

config VIDEO_SAMSUNG_V4L2
	bool "V4L2 API for digital camera to be contributed by samsung"
	depends on VIDEO_DEV && VIDEO_SAMSUNG
	default n
	---help---
	 This feature is for new V4L2 APIs all about digital camera

source "drivers/media/video/samsung/fimc/Kconfig"
#source "drivers/media/video/samsung/post/Kconfig"

if CPU_S5PC100 || CPU_S5PC110 
source "drivers/media/video/samsung/tv20_ap/Kconfig"
source "drivers/media/video/samsung/jpeg_v2/Kconfig"
source "drivers/media/video/samsung/tsi/Kconfig"
endif

if CPU_S5PC100
source "drivers/media/video/samsung/mfc40/Kconfig"
source "drivers/media/video/samsung/rotator/Kconfig"
endif

#if CPU_S3C6410
#source "drivers/media/video/samsung/mfc10/Kconfig"
#source "drivers/media/video/samsung/jpeg/Kconfig"
#source "drivers/media/video/samsung/tv/Kconfig"
#endif

if CPU_S5PC110
source "drivers/media/video/samsung/mfc50/Kconfig"
endif
#
#source "drivers/media/video/samsung/rotator/Kconfig"
#source "drivers/media/video/samsung/g2d/Kconfig"
#source "drivers/media/video/samsung/g3d/Kconfig"
#
#if CPU_S5P6440
#source "drivers/media/video/samsung/gvg/Kconfig"
#endif
#
#source "drivers/media/video/samsung/cmm/Kconfig"
#
#if CPU_S3C6410
#source "drivers/media/video/samsung/rp/Kconfig"
#endif
#
if VIDEO_SAMSUNG

comment "Reserved memory configurations"

config VIDEO_SAMSUNG_MEMSIZE_FIMC0
	int "Memory size in kbytes for FIMC0"
	depends on VIDEO_FIMC
	default "5120"

config VIDEO_SAMSUNG_MEMSIZE_FIMC1
	int "Memory size in kbytes for FIMC1"
	depends on VIDEO_FIMC
	default "5120"

config VIDEO_SAMSUNG_MEMSIZE_FIMC2
	int "Memory size in kbytes for FIMC2"
	depends on VIDEO_FIMC
	default "5120"

config VIDEO_SAMSUNG_MEMSIZE_POST
	int "Memory size in kbytes for Post Processor"
	depends on VIDEO_POST
	default "8192"

config VIDEO_SAMSUNG_MEMSIZE_TV
	int "Memory size in kbytes for TV"
	depends on VIDEO_TV
	default "8192"

if ARCH_S5PC1XX
config VIDEO_SAMSUNG_MEMSIZE_MFC
	int "Memory size in kbytes for MFC"
	depends on VIDEO_MFC40
	default "32768"

config VIDEO_SAMSUNG_MEMSIZE_JPEG
	int "Memory size in kbytes for JPEG"
	depends on VIDEO_JPEG_V2 
	default "32768"
endif

if ARCH_S5PC11X
config VIDEO_SAMSUNG_MEMSIZE_MFC0
	int "Memory size in kbytes for MFC port0"
	depends on VIDEO_MFC50
	default "32768"

config VIDEO_SAMSUNG_MEMSIZE_MFC1
	int "Memory size in kbytes for MFC port1"
	depends on VIDEO_MFC50
	default "32768"

config VIDEO_SAMSUNG_MEMSIZE_JPEG
	int "Memory size in kbytes for JPEG"
	depends on VIDEO_JPEG_V2 
	default "32768"

config VIDEO_SAMSUNG_MEMSIZE_TEXSTREAM
	int "Memory size in kbytes for Texture Stream"
	default "6144"
endif

config VIDEO_SAMSUNG_MEMSIZE_CMM
	int "Memory size in kbytes for CMM"
	depends on VIDEO_CMM && CPU_S3C6410
	default "0"

if CPU_S5P6440
config VIDEO_SAMSUNG_MEMSIZE_GVG
	int "Memory size in kbytes for OpenVG"
	depends on VIDEO_GVG
	default "12288"
endif 

endif
```

## drivers/media/video/samsung/fimc/Kconfig
```kconfig
config VIDEO_FIMC
	bool "Samsung Camera Interface (FIMC) driver"
	depends on VIDEO_SAMSUNG && (CPU_S5PC100 || CPU_S5PC110)
	default n
	---help---
	  This is a video4linux driver for Samsung FIMC device.

choice
depends on VIDEO_FIMC
prompt "Select CSC Range config"
default VIDEO_FIMC_RANGE_NARROW
config VIDEO_FIMC_RANGE_NARROW
	bool "Narrow"
	depends on VIDEO_FIMC && (CPU_S5PC100 || CPU_S5PC110)
	---help---
	  RGB <-> YUV Color Conversion Narrow Range Equation

config VIDEO_FIMC_RANGE_WIDE
	bool "Wide"
	depends on VIDEO_FIMC && (CPU_S5PC100 || CPU_S5PC110)
	---help---
	  RGB <-> YUV Color Conversion Wide Range Equation
endchoice	

config VIDEO_FIMC_DEBUG
	bool "FIMC driver debug messages"
	depends on VIDEO_FIMC

config VIDEO_FIMC_MIPI
	bool "MIPI-CSI2 Slave Interface support"
	depends on VIDEO_FIMC && (CPU_S5PC100 || CPU_S5PC110)

config VIDEO_IPC
	bool "IPC support"
	depends on VIDEO_FIMC && CPU_S5PC110
```

## drivers/media/video/samsung/mfc40/Kconfig
```kconfig
#
# Configuration for Multi Format Codecs (MFC)
#
#
config VIDEO_MFC40
	bool "Samsung MFC (Multi Format Codec - FIMV 4.0) Driver" 
	depends on VIDEO_SAMSUNG && CPU_S5PC100
	default n
	---help---
	  This is a Samsung Multi Format Codecs (MFC) FIMV V4.0 - driver for Samsung S5PC100

config VIDEO_MFC_MAX_INSTANCE
	int "Maximum size of MFC instance (1-4)"
	range 1 4
	depends on VIDEO_MFC40 && ARCH_S5PC1XX
	default 1

config VIDEO_MFC40_DEBUG
	bool "print MFC debug message"
	depends on VIDEO_MFC40
	default n
```

## drivers/media/video/samsung/mfc50/Kconfig
```kconfig
#
# Configuration for Multi Format Codecs (MFC)
#
#
config VIDEO_MFC50
	bool "Samsung MFC (Multi Format Codec - FIMV 5.0) Driver" 
	depends on VIDEO_SAMSUNG && CPU_S5PC110
	default n
	---help---
	  This is a Samsung Multi Format Codecs (MFC) FIMV V5.0 - driver for Samsung S5PC110

config VIDEO_MFC_MAX_INSTANCE
	int "Maximum size of MFC instance (1-4)"
	range 1 4
	depends on VIDEO_MFC50 && ARCH_S5PC11X
	default 4

config VIDEO_MFC50_DEBUG
	bool "print MFC debug message"
	depends on VIDEO_MFC50
	default n
```

## drivers/media/video/samsung/rotator/Kconfig
```kconfig
#
# Configuration for rotator
#

config VIDEO_ROTATOR
	bool "Samsung Image Rotator Driver" 
	depends on VIDEO_SAMSUNG && (CPU_S3C6410 || CPU_S5PC100)
	default n
	---help---
	  This is a Rotator for Samsung S3C6410 and S5PC100.
```

## drivers/media/video/samsung/tsi/Kconfig
```kconfig
#
# Configuration for rotator
#

config VIDEO_TSI
	bool "Samsung Transport Stream Interface" 
	depends on VIDEO_SAMSUNG && (CPU_S5PC110)
	default n
	---help---
	  This is a Transport Stream Interface for Samsung  S5PC110.

config VIDEO_TSI_DEBUG
	bool "print TSI debug message"
	depends on VIDEO_TSI
	default n
config TSI_LIST_DEBUG
	bool "print TSI list debug message"
	depends on VIDEO_TSI
	default n
```

## drivers/media/video/samsung/tv20_ap/Kconfig
```kconfig
#
# Configuration for Post Porcessor
#
#config S5PC100_TVOUT
#        bool "S5PC100 TV-out device support"
#        depends on (VIDEO_DEV=y)
#        default y if VIDEO_DEV

config VIDEO_TV20
	bool "Samsung TV Driver for s5pc1xx & s5pc11x" 
	depends on VIDEO_SAMSUNG
	default n
	---help---
	  This is a TV driver for Samsung SMDK_S5PC100 & SMDK_S5PC110
```

## drivers/net/wireless/bcm4325/Kconfig
```kconfig
config BROADCOM_WIFI
	default m
	tristate "Broadcom WiFi Driver"
	---help---
		Select this option to build Broadcom wlan driver
#config BCM_EMBED_FW
#	default n
#	bool "Broadcom Embed FW into WiFi Driver"
#	depends on BROADCOM_WIFI != n
#	---help---
#		Select this option to embed firmware into wlan driver
```

## drivers/pwm/Kconfig
```kconfig
#
# PWM Timer configuration
#

menu "Pulse Width Modulation Timer"

config PWM
	tristate "Pulse Width Modulation (PWM) Timer support"

config S3C6410_PWM
         bool "S3C6410/30 PWM support"
         depends on CPU_S3C6410 && PWM
         help
           S3C6410 PWM support.
endmenu
```

## drivers/sec/Kconfig
```kconfig
#
# SEC subsystem configuration
#

menuconfig SEC
	bool "SEC specific drivers support"
	---help---
    Samsung Specific drivers

if SEC

source "drivers/sec/dprintk/Kconfig

endif # SEC
```

## drivers/sec/dprintk/Kconfig
```kconfig
#
# dprintk Configuration
#

config SEC_DPRINTK

	bool "dprintk support"
	default y
	help
	This option enables dprintk function  
```

## drivers/sensor/Kconfig
```kconfig
#
#
#


menuconfig NEW_SENSORS
	bool "Sensors Support"
	help
	  Say Y to enable Sensors support.  This allows control of supported
	  Sensors.

	  
	  

if NEW_SENSORS

source "drivers/sensor/accel/Kconfig"

source "drivers/sensor/compass/Kconfig"

source "drivers/sensor/optical/Kconfig"



endif # NEW_SENSORS
```

## drivers/sensor/accel/Kconfig
```kconfig
#
# Accelerometer Sensor Configuration
#



config ACCEL                                                              
	bool "Accelerometer Sensor"
	default y
	help
	This option enables accelerometer sensors  
	   

config ACCEL_BMA020
	depends on ACCEL
	tristate "BMA020 driver for s3c6410"
	default y
	help
	  This option enables accelerometer sensors using bma020 driver.
	  It is optimized for s3c6410.


config ACCEL_KXSD9
	depends on ACCEL
	tristate "KXSD9 driver for s3c6410"
	default n
	help
	  This option enables accelerometer sensors using KXSD9 driver.
	  It is optimized for s3c6410.
	  
```
