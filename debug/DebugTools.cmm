;/**
;* @file DebugTools.cmm
;* @brief CMM file for Linux Debug
;* @author etinum
;* @Copyright 2010 Samsung Electronics Co., Ltd.
;* @version 0.1
;* @date 2010.03.25
;*/


WINPOS 0. 0. 35. 28. 0. 0. LIST NORMAL "Debug Tool v0.1 for Linux 2.6.29"

DIALOG
(
;============== Show Kernel Log =================
  pos 2. 0.5 18. 1.2
  TEXT "Message Logs"
  
  pos 2. 2. 15. 1.2
BTNKERNLOG:  BUTTON "View Kernel Log"
  (
    do _terminal.cmm
  )
;============== Debug variables =================
  pos 2. 3.5 18. 1.2
  TEXT "Debug variables"

  pos 2. 5. 15. 1.2
  BUTTON "View current task struct"
  (
    local &sp
    &sp=r(r13)
     v.v (struct task_struct *)((struct thread_info*)(&sp&~0x1fff))->task
  )

  pos 18. 5. 15. 1.2
  BUTTON "View Timer list"
  (
    v.v per_cpu__tvec_bases
  )

  pos 2. 6.5 15. 1.2
  BUTTON " "
  (
    
  )
;  pos 18. 6.5 15. 1.2
;  MSGLOGINFO: EDIT "" ""



;=============== Display ==============================
  pos 2. 10. 10. 1.2
  TEXT "Display"

  pos 2. 11.5 8. 1.1
  TEXT "Buffer Addr:"
  pos 10. 11.5 23. 1.2
  DISPADDR: EDIT "0xff000000" ""

  pos 2. 13.5 2. 1.1
  TEXT "X:"
  pos 4. 13.5 4. 1.2
  DISPXSIZE: EDIT "240" ""

  pos 8.5 13.5 2. 1.1
  TEXT "Y:"
  pos 10.5 13.5 4. 1.2
  DISPYSIZE: EDIT "400" ""

  pos 15.5 13.5 5. 1.1
  TEXT "Color:"
  pos 20.5 13.5 10. 1.2
  COLORFORMAT: EDIT "RGBX888LE" ""

  pos 2. 15.5 15. 1.2
  BUTTON "View display buffer"
  (
    gosub ShowDispBuffer
  )

;=============== Other Tools ===========================
  pos 2. 22. 15. 1.2
  TEXT "Other Tools"

;== First Column
  pos 2. 23.5 15. 1.2
  BUTTON "(EMPTY)"
  (
  )

  BUTTON "(EMPTY)"
  (
  )

BTNBREWDBG:  BUTTON "(EMPTY)"
  (
  )
;== Second Column
  pos 18. 23.5 15. 1.2
  BUTTON "(EMPTY)"
  (
  )
  BUTTON "(EMPTY)"
  (
  )
  BUTTON "(EMPTY)"
  (
  )
;=======================================================

  CLOSE "jumpto WINCLOSE"
)

SCREEN

gosub Main

STOP

WINCLOSE:
  DIALOG.END
  ENDDO


Main:

  return


ShowDispBuffer:
  local &DISPX
  local &DISPY
  local &DISPBUF
  local &DISPCF
  &DISPX=dialog.string(DISPXSIZE)
  &DISPY=dialog.string(DISPYSIZE)
  &DISPBUF=dialog.string(DISPADDR)
  &DISPCF=dialog.string(COLORFORMAT)
  d.image &DISPBUF &DISPX. &DISPY. /&DISPCF
  return



