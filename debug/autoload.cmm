// Autoload script, called by TRACE32 if symbols are to be loaded

// define local macros
 local &filename &basename &progname &symfilename &filepath &code &data &space

// get filename and relocation information
 // these parameters are passed from TRACE32 when calling this skript
 
 entry &filename &type &code &data &space
 
 //print "autoload: " &filename " " &type " " &code " " &data " " &space
 
 // &filename:      name of process/file
 // &type:          type of file: 1=process, 2=library, 3=kernel module
 // &code:          text segment address
 // &data:          data segment address
 // &space:         space id of process
 
// get symbol file name and program name
 &basename=string.cut(&filename,-string.len(os.file.extension(&filename)))
 if (&type==1)
   &symfilename="&basename"
 if (&type==2)
   &symfilename="&basename"+".so"
 if (&type==3)
   &symfilename="&basename"+".ko"
 &progname=os.file.name("&basename")

// delete symbols if they already exist
 if y.exist("\\&progname")
   sYmbol.Delete \\&progname
 GROUP.Delete "&progname"

// search file in source search path and open dialog when not there
 &filepath=y.searchfile("&symfilename")
 if !os.file("&filepath")
 (
   local &file &spath
   &file=os.file.name("&symfilename")
   winpos ,,,,,, filebox normal "Searching symbols for &filename"
   dialog.file "*\&file"
   entry %line &filepath
   if "&filepath"==""
     enddo
   &spath=os.file.path("&filepath")
   sYmbol.SourcePATH.Set &spath
 )

// load symbol file (options for sourcepath, e.g. /STRIPPART may need to be added when required)

 if (&type==1)  // processes
 (
   Data.LOAD.Elf "&filepath" &space:0 /nocode /noclear
   if task.y.o(mmuscan)==1      // scan only if TRANSlation.TABLEWALK not configured
     MMU.TaskPageTable.SCAN &space:0
   GROUP.Create "&progname" &space:0x0--0xffffffff /GREEN
 )
 
 if (&type==3)  // modules
 (
   local  &reloc &magic &secaddr &secname

   &magic=task.mod.magic("&progname")
 
   &reloc=""
   &i=1
   &secaddr=task.mod.secaddr(&magic,&i)
   while &secaddr!=0xffffffff
   (
     &secname=task.mod.secname(&magic,&i)
     &reloc="&reloc"+" /reloc &secname at &secaddr"
     &i=&i+1
     &secaddr=task.mod.secaddr(&magic,&i)
   )

   Data.LOAD.Elf &filepath 0:0 /nocode /noclear &reloc
   ;MMU.SCAN ALL     // not necessary: done by TRANSlation.TABLEWALK
   GROUP.Create "&progname" y.secrange(\\&progname\.text) /YELLOW
 )
 
 if ((&type&0xffff)==2) // libraries
 (
   Data.LOAD.Elf &filepath &space:&code /nocode /noclear
 )
 
 enddo

