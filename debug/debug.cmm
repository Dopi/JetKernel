;
; LINUX DEBUG CMM for VINSQ
;  RAM physical address : 0x50000000
;                  size : 0x10000000
;

 local &phyramaddr
 local &ramsize

;declare local variables
 local &debugtype
 local &appname
 local &modname

 
; Specify target specific configs
 &phyramaddr=0x50000000
 &ramsize=0x10000000
 &modemramsize=0x2000000

 &modemdumpmagic=0x504d444d
 &modemdumpmagicaddr=0x0
 
 screen.on

 winpage.reset
 area.reset
 WINPOS 0.0 0.076923 90. 25. 0. 0. W000
 area
 

goto MainMenu

;#################### FUNCTIONS ######################
;=====================================================
StartAppDebug:
;=====================================================
  ; -------- Application Debugging --------------
  
   ; activate autoloader for processes:
   TASK.sYmbol.Option AutoLoad Process
   
   print
   print "========================================="
   print "Enter application name to debug... "
   enter &CHOICE
   &appname="&CHOICE"
  
  
   ; script based
     ; using the script based application debugging
     ; gives more control over the single commands
     ; see file "app_debug.cmm"
     
     ;do app_debug &appname
     
   ; process watch system
     ; the process watch system automates the actions
     ; for application debugging
     
     WINPOS 55. 25. 40. 4.
     TASK.Watch.View "&appname"
  
return
;=====================================================


;=====================================================
StartModuleDebug:
;=====================================================
   ; activate autoloader for modules
   TASK.sYmbol.Option AutoLoad Module

   print 
   print "========================================="
   print "Enter Module name to debug... "
   enter &CHOICE
   
   &modname="&CHOICE"

   do mod_debug modname
   
return
;=====================================================



;=====================================================
StartRamdumpAnalysis:
;=====================================================

 sys.cpu arm1176jzf
 SYStem.Option mmu on ;
 SYStem.Option dacr on ; give Debugger global write permissions
 SYStem.Option MMUSPACES ON     ; enable space ids to virtual addresses
 SYS.UP

 ;load linux symbols
 print "Select vmlinux file..."
 Data.LOAD.Elf *vmlinux* /nocode /relpath

 ;load dump binary
 print "Select dump binary..."
 local &fname
 dialog.file *
 entry %line &fname
 d.load.binary "&fname" a:0x0++0x1000 /nosymbol /noclear
 if data.long(a:&modemdumpmagicaddr)!=&modemdumpmagic
 (
   &modemramsize=0
   print "modem dump not in 0x0"
 )
 d.load.binary "&fname" &phyramaddr-&modemramsize /nosymbol /noclear

 mmu.reset
; Declare the MMU format to the debugger
 ; - table format is "LINUX"
 ; - table base address is at label "swapper_pg_dir"
 ; - kernel address translation
 ; Map the virtual kernel symbols to physical addresses to give 
 ; the debugger access to it before CPU MMU is initialized

; print "initializing debugger MMU..."
 MMU.FORMAT LINUX swapper_pg_dir 0xc0000000--(0xc0000000+&ramsize-1) &phyramaddr
 
 ; prepare debugger translation
 TRANSlation.Create 0xc0000000--(0xc0000000+&ramsize-1) &phyramaddr   ; map kernel pages at RAM start
 TRANSlation.COMMON 0xc0000000--0xffffffff              ; common area for kernel and processes
 TRANSlation.TableWalk ON       ; debugger uses a table walk to decode virtual addresses
 TRANSlation.ON                 ; switch on debugger(!) address translation 
 

; Initialize Linux Awareness

 ; Note that the Linux awareness needs the kernel symbols to work
 
 print "initializing Linux support..."
 TASK.CONFIG linux          ; loads Linux awareness (linux.t32)
 MENU.ReProgram linux       ; loads Linux menu (linux.men)
 HELP.FILTER.Add rtoslinux  ; add linux awareness manual to help filter

 TASK.sYmbol.Option MMUSCAN OFF  ; not necessary with tablewalk
 
 ; switch on symbol autoloader
 
 sYmbol.AutoLoad.CHECKLINUX "do "+os.ppd()+"/autoload "
 
 ; Group kernel area to be displayed with red bar
 GROUP.Create "kernel" 0xc0000000--0xffffffff /RED

 print "All setup is complete!"


 ; --- switch on MMU so that we can read the MMU register information from kernel variable ---
 MMU.ON
 
 ; --- setup mmu registers ---
 if (!y.exist(kernel_sec_mmu_reg_dump))
 (
 dialog.message "'kernel_sec_mmu_reg_dump' symbol not found. Are you using the right VMLINUX image? Cannot proceed further!"
 stop
 )
 
 ; --- Populate the MMU registers ---
 print "Loading MMU registers"
 PER.S C15:0x1 	%LONG	v.value("*((unsigned int*)&kernel_sec_mmu_reg_dump+0x0)")	;SCTLR
 PER.S C15:0x2 	%LONG 	v.value("*((unsigned int*)&kernel_sec_mmu_reg_dump+0x1)")	;TTBR0
 PER.S C15:0x102 	%LONG 	v.value("*((unsigned int*)&kernel_sec_mmu_reg_dump+0x2)")	;TTBR1
 PER.S C15:0x202 	%LONG 	v.value("*((unsigned int*)&kernel_sec_mmu_reg_dump+0x3)")	;TTBCR
 PER.S C15:0x3 	%LONG 	v.value("*((unsigned int*)&kernel_sec_mmu_reg_dump+0x4)")	;DACR
 PER.S C15:0x5 	%LONG 	v.value("*((unsigned int*)&kernel_sec_mmu_reg_dump+0x5)")	;DFSR
 PER.S C15:0x6 	%LONG 	v.value("*((unsigned int*)&kernel_sec_mmu_reg_dump+0x6)")	;DFAR
 PER.S C15:0x105 	%LONG 	v.value("*((unsigned int*)&kernel_sec_mmu_reg_dump+0x7)")	;IFSR
 PER.S C15:0x206 	%LONG 	v.value("*((unsigned int*)&kernel_sec_mmu_reg_dump+0x8)")	;IFAR
 PER.S C15:0x15 	%LONG 	v.value("*((unsigned int*)&kernel_sec_mmu_reg_dump+0x9)")	;DAFSR
 PER.S C15:0x115 	%LONG 	v.value("*((unsigned int*)&kernel_sec_mmu_reg_dump+0xA)")	;IAFSR
 PER.S C15:0x2A 	%LONG 	v.value("*((unsigned int*)&kernel_sec_mmu_reg_dump+0xB)")	;PMRRR
 PER.S C15:0x12A 	%LONG 	v.value("*((unsigned int*)&kernel_sec_mmu_reg_dump+0xC)")	;NMRRR
 PER.S C15:0x0D 	%LONG 	v.value("*((unsigned int*)&kernel_sec_mmu_reg_dump+0xD)")	;FCSEPID
 PER.S C15:0x10D 	%LONG 	v.value("*((unsigned int*)&kernel_sec_mmu_reg_dump+0xE)")	;CONTEXT
 PER.S C15:0x20D 	%LONG 	v.value("*((unsigned int*)&kernel_sec_mmu_reg_dump+0xF)")	;URWTPID
 PER.S C15:0x30D 	%LONG 	v.value("*((unsigned int*)&kernel_sec_mmu_reg_dump+0x10)")	;UROTPID
 PER.S C15:0x40D 	%LONG 	v.value("*((unsigned int*)&kernel_sec_mmu_reg_dump+0x11)")	;POTPIDR
 
 ; --- Populate the CPU registers ---
 if (y.exist(kernel_sec_core_reg_dump))
 (
 print "Loading CPU registers"
 
 ; -- R0-R12, PC and CPSR ---
 R.S R0 v.value("kernel_sec_core_reg_dump.r0")
 R.S R1 v.value("kernel_sec_core_reg_dump.r1")
 R.S R2 v.value("kernel_sec_core_reg_dump.r2")
 R.S R3 v.value("kernel_sec_core_reg_dump.r3")
 R.S R4 v.value("kernel_sec_core_reg_dump.r4")
 R.S R5 v.value("kernel_sec_core_reg_dump.r5")
 R.S R6 v.value("kernel_sec_core_reg_dump.r6")
 R.S R7 v.value("kernel_sec_core_reg_dump.r7")
 R.S R8 v.value("kernel_sec_core_reg_dump.r8")
 R.S R9 v.value("kernel_sec_core_reg_dump.r9")
 R.S R10 v.value("kernel_sec_core_reg_dump.r10")
 R.S R11 v.value("kernel_sec_core_reg_dump.r11")
 R.S R12 v.value("kernel_sec_core_reg_dump.r12")
 
 ; --- SVC ---
 R.S R13_SVC v.value("kernel_sec_core_reg_dump.r13_svc")
 R.S R14_SVC v.value("kernel_sec_core_reg_dump.r14_svc")
 
 ; --- CPSR & PC ---
 R.S PC v.value("kernel_sec_core_reg_dump.pc")
 R.S CPSR v.value("kernel_sec_core_reg_dump.cpsr")
 
 ; --- USR/SYS ---
 R.S R13_USR v.value("kernel_sec_core_reg_dump.r13_usr")
 R.S R14_USR v.value("kernel_sec_core_reg_dump.r14_usr")
 
 ; --- FIQ ---
 R.S R8_FIQ v.value("kernel_sec_core_reg_dump.r8_fiq")
 R.S R9_FIQ v.value("kernel_sec_core_reg_dump.r9_fiq")
 R.S R10_FIQ v.value("kernel_sec_core_reg_dump.r10_fiq")
 R.S R11_FIQ v.value("kernel_sec_core_reg_dump.r11_fiq")
 R.S R12_FIQ v.value("kernel_sec_core_reg_dump.r12_fiq")
 R.S R13_FIQ v.value("kernel_sec_core_reg_dump.r13_fiq")
 R.S R14_FIQ v.value("kernel_sec_core_reg_dump.r14_fiq")
 R.S SPSR_FIQ v.value("kernel_sec_core_reg_dump.spsr_fiq")
 
 ; --- IRQ ---
 R.S R13_IRQ v.value("kernel_sec_core_reg_dump.r13_irq")
 R.S R14_IRQ v.value("kernel_sec_core_reg_dump.r14_irq")
 R.S SPSR_IRQ v.value("kernel_sec_core_reg_dump.spsr_irq")
 
 ; --- MON ---
 R.S R13_MON v.value("kernel_sec_core_reg_dump.r13_mon")
 R.S R14_MON v.value("kernel_sec_core_reg_dump.r14_mon")
 R.S SPSR_MON v.value("kernel_sec_core_reg_dump.spsr_mon")
 
 ; --- ABT ---
 R.S R13_ABT v.value("kernel_sec_core_reg_dump.r13_abt")
 R.S R14_ABT v.value("kernel_sec_core_reg_dump.r14_abt")
 R.S SPSR_ABT v.value("kernel_sec_core_reg_dump.spsr_abt")
 
 ; --- UNDEF ---
 R.S R13_UND v.value("kernel_sec_core_reg_dump.r13_und")
 R.S R14_UND v.value("kernel_sec_core_reg_dump.r14_und")
 R.S SPSR_UND v.value("kernel_sec_core_reg_dump.spsr_und")
 )
 
 ; --- Inititate a table walk, so that mmu tables are programmed based on the MMU details populated above ---
 TASK.sYmbol.Option MMUSCAN OFF  ; not necessary with tablewalk
 MMU.TableWalk ON

 return
;=====================================================

;=====================================================
SetupT32:
;=====================================================

; Debugger Reset
 print "resetting..."
 RESet

; Initializing Debugger
 
 print "initializing..."

 SYStem.CPU arm1176jzf
 SYStem.JC RTCK
 SYStem.Option mmu off ; turn mmu off
 SYStem.Option dacr on ; give Debugger global write permissions
 SYStem.Option enreset off
 SYStem.Option trst off
 SYStem.MultiCore IRPRE 4
 SYStem.MultiCore DRPRE 1
 SYStem.MultiCore ETBIRPOST 5
 SYStem.MultiCore ETBDRPOST 1

 TrOnchip.Set DABORT OFF
 TrOnchip.Set PABORT OFF
 TrOnchip.Set UNDEF OFF         ; may be used by Linux for FPU detection
 SYStem.Option MMUSPACES ON     ; enable space ids to virtual addresses

 sys.m.a

 SETUP.IMASKASM ON              ; lock interrupts while single stepping

 break

 ;load linux symbols
 Data.LOAD.Elf ../vmlinux /nocode /strippart 12.

  
; Declare the MMU format to the debugger
 ; - table format is "LINUX"
 ; - table base address is at label "swapper_pg_dir"
 ; - kernel address translation
 ; Map the virtual kernel symbols to physical addresses to give 
 ; the debugger access to it before CPU MMU is initialized

; print "initializing debugger MMU..."
 MMU.FORMAT LINUX swapper_pg_dir 0xc0000000--(0xc0000000+&ramsize-1) &phyramaddr
 
 ; prepare debugger translation
 TRANSlation.Create 0xc0000000--(0xc0000000+&ramsize-1) &phyramaddr   ; map kernel pages at RAM start
 TRANSlation.COMMON 0xc0000000--0xffffffff              ; common area for kernel and processes
 TRANSlation.TableWalk ON       ; debugger uses a table walk to decode virtual addresses
 TRANSlation.ON                 ; switch on debugger(!) address translation 
 

; Initialize Linux Awareness

 ; Note that the Linux awareness needs the kernel symbols to work
 
 print "initializing Linux support..."
 TASK.CONFIG linux          ; loads Linux awareness (linux.t32)
 MENU.ReProgram linux       ; loads Linux menu (linux.men)
 HELP.FILTER.Add rtoslinux  ; add linux awareness manual to help filter

 TASK.sYmbol.Option MMUSCAN OFF  ; not necessary with tablewalk
 
 ; switch on symbol autoloader
 
 sYmbol.AutoLoad.CHECKLINUX "do "+os.ppd()+"/autoload "
 
 ; Group kernel area to be displayed with red bar
 GROUP.Create "kernel" 0xc0000000--0xffffffff /RED

 print "All setup is complete!"

 b.s start_kernel /onchip 
 print "Waiting for kernel to load..."
 go
 wait !run() ; go till start_kernel and stop
 print "Kernel load complete. Stopped at start_kernel()"

 ;-------- Set Autoloader options -------
 task.symbol.option autoload Process
 task.symbol.option autoload Module
 task.symbol.option autoload Library

 return
;=====================================================





;=====================================================
MainMenu:
;=====================================================
 print "========================================="
 print "      _     _                            "
 print "     | |   (_)_ __  _   ___  __          "
 print "     | |   | | '_ \| | | \ \/ /          "
 print "     | |___| | | | | |_| |>  <           "
 print "     |_____|_|_| |_|\__,_/_/\_\          "
 print "                                         "
 print "                                         "
 print "      ____       _                       "
 print "     |  _ \  ___| |__  _   _  __ _       "
 print "     | | | |/ _ \ '_ \| | | |/ _` |      "
 print "     | |_| |  __/ |_) | |_| | (_| |      "
 print "     |____/ \___|_.__/ \__,_|\__, |      "
 print "                            |___/        "
 print "                                         "
 print "     2010 Samsung CDMA S/W Lab           "
 print "========================================="
 print 
 print "Choose debug type... "
 print " 0. Just Kernel~"
 print " 1. Modules"
 print " 2. Application"
 print " 3. Simulator (Ram Dump Analysis)"
 print " Enter your choice : "
 
 enter &CHOICE
 &debugtype="&CHOICE"

 if &debugtype==0
 (
   gosub SetupT32
 )

 if &debugtype==1
 (
   gosub SetupT32
   gosub StartModuleDebug
   go
 )

 if &debugtype==2
 (
   gosub SetupT32
   gosub StartAppDebug
   go
 )

 if &debugtype==3
 (
   gosub StartRamdumpAnalysis
 )
 
 WINPOS 99.0 42.154 79. 17. 0. 1. W004
 WINTABS 10. 15. 10. 8. 9. 9. 8.
 TASK.MODule
 
 WINPOS 98.714 9.8462 79. 28. 0. 1. W003
 WINTABS 9. 17. 11. 7. 7. 8. 5. 9.
 TASK.DTask
 
 WINPOS 0.0 0.076923 133. 6. 0. 0. W000
 area
 
 WINPOS 0.28571 10.462 94. 14. 30. 1. W005
 WINTABS 24.
 sYmbol.AutoLoad.List
 
 WINPOS 0.14286 30.308 94. 27. 21. 1. W002
 WINTABS 10. 10. 25. 62.
 Data.List
 
 do DebugTools.cmm

 WINPAGE.SELECT P000     
  
 enddo

 return
 ;=====================================================



